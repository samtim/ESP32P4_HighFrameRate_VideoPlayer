## sdkconfig.defaults
```kconfig
# ==============================================================================
# Target Device Configuration
# ==============================================================================
CONFIG_IDF_TARGET="esp32p4"

# 设置 CPU 主频为 400MHz (保证 MIPI-DSI 的 20MHz 参考 PLL 时钟分频与计算正常)
CONFIG_ESP32P4_CPU_CLK_400M=y

# ==============================================================================
# PSRAM (SPIRAM) Configuration
# 600x1024 帧缓冲区与 MJPEG 解码缓冲区依赖 PSRAM
# ==============================================================================
CONFIG_SPIRAM=y
CONFIG_SPIRAM_SPEED_200M=y

# ==============================================================================
# Cache & Memory Optimization
# 开启 256KB L2 Cache 和 128B Cache Line，提升 DMA2D 刷屏与解码吞吐率
# ==============================================================================
CONFIG_CACHE_L2_CACHE_256KB=y
CONFIG_CACHE_L2_CACHE_LINE_128B=y

# ==============================================================================
# FatFS (SD Card) Configuration
# 支持 SD 卡长文件名 (如 video_600x1024_demo.mjpeg)
# ==============================================================================
CONFIG_FATFS_LFN_HEAP=y
CONFIG_FATFS_MAX_LFN=255

# ==============================================================================
# FreeRTOS & System Configuration
# ==============================================================================
CONFIG_FREERTOS_HZ=1000
CONFIG_ESP_MAIN_TASK_STACK_SIZE=8192
```
